/* Copyright (c) 2020 The ZMK Contributors
 * SPDX-License-Identifier: MIT */
        #include <behaviors.dtsi>
        #include <dt-bindings/zmk/keys.h>
        #include <dt-bindings/zmk/bt.h>
//        #include <dt-bindings/zmk/outputs.h>
//      #define NUMBERS 0;
//      #define SYMBOLS 1;
//      #define LOGICAL 2;
    / {
/*        behaviors {         // added behaviors: tbd qex bsd csc pcl aus afs cse lcs rcs snl ssl lsk lcc rcc
        //  SHIFTED KEYS 'SWITCHING PARTNERS' BEHAVIORS
            tbm: tab_minus { compatible = "zmk,behavior-mod-morph"; label ="tbm"; #binding-cells = <0>; bindings = <&kp TAB>, <&kp MINUS>; mods = <(MOD_RSFT)>; keep-mods = <(MOD_RSFT)>; };
  vv    qex: question_exclaim { compatible = "zmk,behavior-mod-morph"; label = "qex"; #binding-cells = <0>; bindings = <&kp QMARK>, <&kp EXCL>; mods = <(MOD_RSFT)>; keep-mods = <(MOD_RSFT)>; };
        csc: comma_semicolon { compatible = "zmk,behavior-mod-morph"; label = "csc"; #binding-cells = <0>; bindings = <&kp COMMA>, <&kp SEMI>; mods = <(MOD_RSFT)>; };
 comma_pipe: comma_pipe { compatible = "zmk,behavior-mod-morph"; label = "comma_pipe"; #binding-cells = <0>; bindings = <&kp ((((0x07) << 16) | (0x36)))>, <&kp (((((0x07) << 16) | (0x31))))>; mods = <(0x02|0x20)>; masked_mods = <(0x02)>; };
        pcl: period_colon { compatible = "zmk,behavior-mod-morph"; label = "pcl"; #binding-cells = <0>; bindings = <&kp DOT>, <&kp COLON>; mods = <(MOD_LSFT|MOD_RSFT)>; keep-mods = <(LSFT)>; };
        bsd: backspace_delete { compatible = "zmk,behavior-mod-morph"; label = "bsd"; #binding-cells = <0>; bindings = <&kp BACKSPACE>, <&kp DELETE>; mods = <(MOD_LSFT|MOD_RSFT)>; keep-mods = <(MOD_RSFT)>; };
        aus: alt_underscore { compatible = "zmk,behavior-mod-morph"; label = "aus"; #binding-cells = <0>; bindings = <&kp LALT>, <&kp UNDER>; mods = <(MOD_RSFT|MOD_LSFT)>; masked_mods = <(MOD_LALT|MOD_LSFT)>; };
        afs: ampersand_forward_slash { compatible = "zmk,behavior-mod-morph"; label = "afs"; #binding-cells = <0>; bindings = <&kp AMPS>, <&kp FSLH>; mods = <(MOD_RSFT)>; masked_mods = <(MOD_RSFT)>; };
        //  SHIFT KEY 'CAPITAL' BEHAVIORS
        cse:  caps_sentence{ compatible = "zmk,behavior-caps-word"; label = "cse"; #binding-cells = <0>; mods = <(MOD_LSFT|MOD_RSFT)>; continue-list = <SPACE>; };
        lcs: left_caps_sentence { compatible = "zmk,behavior-hold-tap"; label = "lcs"; #binding-cells = <2>; tapping-term-ms = <150>; quick-tap-ms = <0>; flavor = "tap-preferred"; bindings = <&tog caps_sent>, <&osk LSHFT>; };
        rcs: right_caps_sentence { compatible = "zmk,behavior-hold-tap"; label = "rcs"; #binding-cells = <2>; tapping-term-ms = <150>; quick-tap-ms = <0>; flavor = "tap-preferred"; bindings = <&kp caps_sent>, <&osk RSHFT>; };
        //  SPACE KEY 'TO LAYERS' BEHAVIORS
        stnl: left_space_to_number { compatible = "zmk,behavior-hold-tap"; label = "stnl"; #binding-cells = <2>; tapping-term-ms = <150>; quick-tap-ms = <0>; flavor = "tap-preferred"; bindings = <&to NUMBERS>, <&kp SPACE>; };
        stsl: right_space_to_symbol_layer { compatible = "zmk,behavior-hold-tap"; label = "stsl"; #binding-cells = <2>; tapping-term-ms = <150>; quick-tap-ms = <0>; flavor = "tap-preferred"; bindings = <&to SYMBOLS>, <&kp SPACE>; };
        //  COMMAND KEY 'CONTROL' BEHAVIORS
        lsk: long_sticky_key { compatible = "zmk,behavior-sticky-key"; label = "lsk"; #binding-cells = <1>; bindings = <&kp>; release-after-ms = <2000>; quick-release; /delete-property/ignore-modifiers; };
        lcc: left_command_control { compatible = "zmk,behavior-hold-tap"; label = "lcc"; #binding-cells = <2>; tapping-term-ms = <150>; quick-tap-ms = <0>; flavor = "tap-preferred"; bindings = <&kp LCMD>, <&osk LCTRL>; };
        rcc: right_command_control { compatible = "zmk,behavior-hold-tap"; label = "rcc"; #binding-cells = <2>; tapping-term-ms = <150>; quick-tap-ms = <0>; flavor = "tap-preferred"; bindings = <&kp RCMD>, <&osk RCTRL>; };
        }; */
        keymap {
     /* TAB|-               QMARK|EXCL  COMMA|SEMI  DOT|COLON  P      Y        M     L    D    C    F        BSPC|DEL
        LALT|UNDER               O          A          E       I      U        H     N    T    R    S        SQT|DQT
        LSHFT|caps sentence  AMPS|FSLH      X          Q       K      J        V     B    G    W    Z  RSHFT|caps sentence
                                        LCMD|LCNTRL  LSPACE|to_numb  RET     RET  RSPACE|to_symb  RCMD|RCNTRL */
            compatible = "zmk-keymap";
            default_layer {
    bindings = <
    &kp TAB   &kp Q &kp W &kp E &kp R &kp T   &kp Y &kp U  &kp I     &kp O   &kp P    &kp BSPC
    &kp LCTRL &kp A &kp S &kp D &kp F &kp G   &kp H &kp J  &kp K     &kp L   &kp SEMI &kp SQT
    &kp LSHFT &kp Z &kp X &kp C &kp V &kp B   &kp N &kp M  &kp COMMA &kp DOT &kp FSLH &kp ESC
    &kp LGUI &mo 1 &kp SPACE   &kp RET &mo 2 &kp RALT
    >;

    /*        bindings = <    // added behaviors: tbm qex csc pcl bsd aus afs cse lcs rcs snl ssl lsk lcc rcc
    &kp TAB    &kp N1    &kp N2    &kp N3    &kp P    &kp Y    &kp M    &kp L    &kp D    &kp C    &kp F   &kp DELETE
    &kp LALT   &kp O     &kp A     &kp E     &kp I    &kp U    &kp H    &kp N    &kp T    &kp R    &kp S   &kp SQT
    &kp LSFT   &kp AMPS  &kp X     &kp Q     &kp K    &kp J    &kp V    &kp B    &kp G    &kp W    &kp Z   &kp RSFT
                            &kp RCMD    &kp RCTRL   &kp RET  &kp RET  &kp LCTRL   &kp LCMD
                >; */
            };
        };
    };
// &qex QMARK   &csc SEMI   &pcl COLON   &bsd DELETE
// &kp AMPS